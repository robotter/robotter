sromTable1:
        db     0ebh,0ffh,045h,028h,0b2h,07eh,0cdh,075h,09eh,013h,05ch,01bh,00fh,05dh,0e0h,096h 
        db     03bh,085h,039h,01ah,0b6h,033h,0b2h,02bh,0b5h,008h,05ch,0a0h,02eh,0dfh,0b8h,0d8h 
        db     0d0h,083h,010h,07fh,049h,058h,0adh,089h,02ch,04fh,0c3h,004h,074h,0c9h,001h,0deh 
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        db     016h,054h,0fbh,084h,010h,034h,026h,02ah,09eh,0cch,04bh,031h,029h,061h,04fh,04dh 
sromTable2:
        db     074h,0f3h,0d0h,051h,094h,012h,026h,076h,071h,02ah,0b1h,0dah,0a2h,081h,05bh,061h 
        db     073h,038h,058h,0b2h,02ch,082h,005h,0dch,000h,00ch,0abh,06eh,0eah,0ebh,0feh,035h 
        db     015h,0a8h,02bh,0c9h,033h,01ah,080h,02fh,0d0h,07eh,0e9h,031h,0c9h,02dh,041h,0b4h 
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        db     00bh,03eh,06ch,05ch,05ch,0e1h,0f8h,0b3h,0eeh,0deh,004h,046h,08ch,08bh,055h,0c3h 
sromTable3:
        db     095h,03eh,03fh,03fh,017h,020h,04fh,01ah,06dh,095h,0d5h,0e4h,06ah,0ebh,082h,093h 
        db     070h,093h,0e0h,063h,0c5h,0c4h,07eh,042h,0f2h,0b8h,01eh,08eh,096h,05dh,0dfh,058h 
        db     0edh,0eeh,0d7h,0cfh,0f9h,03bh,0deh,0c6h,0dfh,099h,0f0h,0c1h,0c2h,08ah,05bh,098h 
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        db     002h,0c4h,0e6h,011h,078h,092h,0e1h,077h,0f0h,04fh,0ech,000h,098h,0c2h,08ah,037h 
sromTable4:
        db     0b1h,0a2h,04eh,0dch,088h,0a8h,081h,055h,059h,0e6h,0ebh,062h,051h,049h,092h,059h 
        db     0cfh,09dh,021h,049h,077h,0d6h,03fh,0c7h,057h,0ffh,0bbh,083h,03ch,05fh,092h,059h 
        db     061h,0c4h,08ch,029h,046h,0a8h,041h,0bdh,0c4h,098h,0eah,0b3h,04ch,04dh,0c2h,05dh 
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        db     058h,0b9h,030h,0abh,0dah,082h,03ah,0d4h,0dbh,083h,09dh,004h,064h,0ceh,023h,06ch 
sromTable5:
        db     07dh,0e2h,0e4h,09ch,023h,020h,05ch,033h,041h,009h,099h,00bh,015h,0f3h,0c5h,018h 
        db     0bbh,040h,0bbh,001h,0f9h,08eh,0f2h,04eh,033h,0adh,0d7h,0f5h,0aeh,0d4h,033h,0a4h 
        db     0e4h,049h,05bh,0fbh,066h,03bh,035h,076h,03bh,07ch,0a0h,018h,04fh,060h,0b7h,0dah 
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        db     0c9h,046h,06eh,08bh,07ch,0b2h,024h,0bah,007h,014h,0f1h,043h,01ch,0d0h,0f9h,004h 
sromTable6:
        db     086h,090h,00fh,0ddh,0adh,0d1h,0e8h,0f1h,010h,053h,0bch,0a1h,023h,0d1h,050h,0d8h 
        db     0a4h,036h,0eah,08fh,0f2h,0a2h,0beh,03ah,03fh,088h,065h,0e3h,075h,03ah,00fh,01dh 
        db     068h,0c6h,00dh,0feh,001h,0ddh,0b4h,027h,07ah,075h,0b0h,0deh,0edh,0ddh,07fh,094h 
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        db     0e5h,038h,0efh,07bh,091h,0feh,004h,0cbh,0c4h,0c6h,075h,03ch,07ah,03ch,0f4h,0e0h 
sromTable7:
        db     0cbh,003h,0ech,075h,0d3h,00bh,00eh,0b1h,07ah,038h,049h,03fh,066h,040h,079h,05fh 
        db     087h,0a3h,05eh,011h,01bh,07ah,0cdh,016h,034h,0a4h,050h,0ech,0a1h,0efh,0a7h,0e3h 
        db     0bfh,0b2h,07ch,034h,070h,04dh,082h,0a9h,04ah,039h,06ah,058h,089h,0bfh,047h,002h 
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        db     0beh,0a1h,082h,0c2h,01ch,035h,0f6h,051h,035h,06dh,0a6h,0f2h,0bbh,024h,0d0h,0bdh 
sromTable8:
        db     035h,000h,0f4h,064h,019h,0ach,0b1h,0e3h,051h,003h,017h,09fh,071h,0bah,027h,031h 
        db     0f5h,034h,009h,018h,039h,0a5h,09fh,0b2h,059h,052h,090h,0afh,04fh,03fh,0e0h,00bh 
        db     094h,094h,085h,0cfh,0cbh,08fh,0cah,09ch,0eeh,089h,0a3h,0a0h,02ch,0cah,025h,097h 
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        db     0b5h,035h 
