---------------------------------------------------------------------------
-- Company     : Automaticaly generated by POD
-- Author(s)   : 
-- 
-- Creation Date : 2009-03-21
-- File          : atmega_wb8_wrapper00_mwb8.vhd
--
-- Abstract : 
-- Connect slaves to mwb8 from atmega_wb8_wrapper00
--
---------------------------------------------------------------------------

library IEEE;
use IEEE.STD_LOGIC_1164.ALL;
use IEEE.numeric_std.all;

Entity atmega_wb8_wrapper00_mwb8 is
    port
    (

        -- adns6010system00_swb8 connection
        adns6010system00_wbs_adr_i               : out  std_logic_vector(5 downto 0);
        adns6010system00_wbs_dat_i               : out  std_logic_vector(7 downto 0);
        adns6010system00_wbs_dat_o               : in   std_logic_vector(7 downto 0);
        adns6010system00_wbs_we_i                : out  std_logic;
        adns6010system00_wbs_stb_i               : out  std_logic;
        adns6010system00_wbs_cyc_i               : out  std_logic;
        adns6010system00_wbs_ack_o               : in   std_logic;

        -- adns6010system00_clock connection
        adns6010system00_wbs_clk_i               : out  std_logic;
        adns6010system00_wbs_rst_i               : out  std_logic;

        -- atmega_wb8_wrapper00_mwb8 connection
        atmega_wb8_wrapper00_wbm_address         : in   std_logic_vector(14 downto 0);
        atmega_wb8_wrapper00_wbm_readdata        : out  std_logic_vector(7 downto 0);
        atmega_wb8_wrapper00_wbm_writedata       : in   std_logic_vector(7 downto 0);
        atmega_wb8_wrapper00_wbm_strobe          : in   std_logic;
        atmega_wb8_wrapper00_wbm_write           : in   std_logic;
        atmega_wb8_wrapper00_wbm_ack             : out  std_logic;
        atmega_wb8_wrapper00_wbm_cycle           : in   std_logic;

        -- atmega_wb8_wrapper00_candr connection
        atmega_wb8_wrapper00_reset               : out  std_logic;
        atmega_wb8_wrapper00_clk                 : out  std_logic;

        -- rstext_syscon00_atmega_wb8_wrapper00 connection
        rstext_syscon00_gls_clk                  : in   std_logic;
        rstext_syscon00_gls_reset                : in   std_logic
    );
end entity;

architecture atmega_wb8_wrapper00_mwb8_1 of atmega_wb8_wrapper00_mwb8 is
    signal adns6010system00_swb8_cs                 : std_logic := '0' ;
begin

    -- Clock and Reset connection
    adns6010system00_wbs_clk_i               <= rstext_syscon00_gls_clk;
    adns6010system00_wbs_rst_i               <= rstext_syscon00_gls_reset;

    atmega_wb8_wrapper00_reset               <= rstext_syscon00_gls_reset;
    atmega_wb8_wrapper00_clk                 <= rstext_syscon00_gls_clk;

    -----------------------
    -- Address decoding  --
    -----------------------
    adns6010system00_wbs_adr_i <= atmega_wb8_wrapper00_wbm_address(5 downto 0);

    decodeproc : process(rstext_syscon00_gls_clk,rstext_syscon00_gls_reset,atmega_wb8_wrapper00_wbm_address)
    begin
        if rstext_syscon00_gls_reset='1' then
            adns6010system00_swb8_cs <= '0';
        elsif rising_edge(rstext_syscon00_gls_clk) then

            if atmega_wb8_wrapper00_wbm_address(14 downto 6)="001001100" and atmega_wb8_wrapper00_wbm_strobe='1' then
                adns6010system00_swb8_cs <= '1';
            else
                adns6010system00_swb8_cs <= '0';
            end if;

        end if;
    end process decodeproc;

    -----------------------------
    -- Control signals to slave
    -----------------------------

    -- for adns6010system00
    adns6010system00_wbs_stb_i <= (atmega_wb8_wrapper00_wbm_strobe and adns6010system00_swb8_cs );
    adns6010system00_wbs_cyc_i <= (atmega_wb8_wrapper00_wbm_cycle and adns6010system00_swb8_cs );
    adns6010system00_wbs_we_i <= (atmega_wb8_wrapper00_wbm_write and adns6010system00_swb8_cs );
    adns6010system00_wbs_dat_i <= atmega_wb8_wrapper00_wbm_writedata when (atmega_wb8_wrapper00_wbm_write and adns6010system00_swb8_cs ) = '1' else (others => '0');


    -------------------------------
    -- Control signal for master --
    -------------------------------
    atmega_wb8_wrapper00_wbm_readdata <=  adns6010system00_wbs_dat_o when adns6010system00_swb8_cs='1' else
                                       (others => '0');
    atmega_wb8_wrapper00_wbm_ack <=  (adns6010system00_wbs_ack_o and adns6010system00_swb8_cs);

end architecture atmega_wb8_wrapper00_mwb8_1;
