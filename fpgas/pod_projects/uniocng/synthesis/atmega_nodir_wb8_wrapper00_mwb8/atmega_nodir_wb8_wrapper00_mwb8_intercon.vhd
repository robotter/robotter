---------------------------------------------------------------------------
-- Company     : Automaticaly generated by POD
-- Author(s)   : 
-- 
-- Creation Date : 2009-05-16
-- File          : atmega_nodir_wb8_wrapper00_mwb8.vhd
--
-- Abstract : 
-- Connect slaves to mwb8 from atmega_nodir_wb8_wrapper00
--
---------------------------------------------------------------------------

library IEEE;
use IEEE.STD_LOGIC_1164.ALL;
use IEEE.numeric_std.all;

Entity atmega_nodir_wb8_wrapper00_mwb8 is
    port
    (

        -- adns601000_swb8 connection
        adns601000_wbs_adr_i                     : out  std_logic_vector(5 downto 0);
        adns601000_wbs_dat_i                     : out  std_logic_vector(7 downto 0);
        adns601000_wbs_dat_o                     : in   std_logic_vector(7 downto 0);
        adns601000_wbs_we_i                      : out  std_logic;
        adns601000_wbs_stb_i                     : out  std_logic;
        adns601000_wbs_cyc_i                     : out  std_logic;
        adns601000_wbs_ack_o                     : in   std_logic;

        -- adns601000_clock connection
        adns601000_wbs_clk_i                     : out  std_logic;
        adns601000_wbs_rst_i                     : out  std_logic;

        -- encoder_inc00_swb8 connection
        encoder_inc00_wbs_adr_i                  : out  std_logic_vector(2 downto 0);
        encoder_inc00_wbs_dat_o                  : in   std_logic_vector(7 downto 0);
        encoder_inc00_wbs_we_i                   : out  std_logic;
        encoder_inc00_wbs_stb_i                  : out  std_logic;
        encoder_inc00_wbs_cyc_i                  : out  std_logic;
        encoder_inc00_wbs_ack_o                  : in   std_logic;

        -- encoder_inc00_clock connection
        encoder_inc00_wbs_clk_i                  : out  std_logic;
        encoder_inc00_wbs_rst_i                  : out  std_logic;

        -- encoder_inc01_swb8 connection
        encoder_inc01_wbs_adr_i                  : out  std_logic_vector(2 downto 0);
        encoder_inc01_wbs_dat_o                  : in   std_logic_vector(7 downto 0);
        encoder_inc01_wbs_we_i                   : out  std_logic;
        encoder_inc01_wbs_stb_i                  : out  std_logic;
        encoder_inc01_wbs_cyc_i                  : out  std_logic;
        encoder_inc01_wbs_ack_o                  : in   std_logic;

        -- encoder_inc01_clock connection
        encoder_inc01_wbs_clk_i                  : out  std_logic;
        encoder_inc01_wbs_rst_i                  : out  std_logic;

        -- encoder_inc02_swb8 connection
        encoder_inc02_wbs_adr_i                  : out  std_logic_vector(2 downto 0);
        encoder_inc02_wbs_dat_o                  : in   std_logic_vector(7 downto 0);
        encoder_inc02_wbs_we_i                   : out  std_logic;
        encoder_inc02_wbs_stb_i                  : out  std_logic;
        encoder_inc02_wbs_cyc_i                  : out  std_logic;
        encoder_inc02_wbs_ack_o                  : in   std_logic;

        -- encoder_inc02_clock connection
        encoder_inc02_wbs_clk_i                  : out  std_logic;
        encoder_inc02_wbs_rst_i                  : out  std_logic;

        -- compass00_swb8 connection
        compass00_wbs_adr_i                      : out  std_logic_vector(1 downto 0);
        compass00_wbs_dat_o                      : in   std_logic_vector(7 downto 0);
        compass00_wbs_we_i                       : out  std_logic;
        compass00_wbs_stb_i                      : out  std_logic;
        compass00_wbs_cyc_i                      : out  std_logic;
        compass00_wbs_ack_o                      : in   std_logic;

        -- compass00_clock connection
        compass00_wbs_clk_i                      : out  std_logic;
        compass00_wbs_rst_i                      : out  std_logic;

        -- led00_swb8 connection
        led00_wbs_add                            : out  std_logic;
        led00_wbs_writedata                      : out  std_logic_vector(7 downto 0);
        led00_wbs_readdata                       : in   std_logic_vector(7 downto 0);
        led00_wbs_strobe                         : out  std_logic;
        led00_wbs_cycle                          : out  std_logic;
        led00_wbs_write                          : out  std_logic;
        led00_wbs_ack                            : in   std_logic;

        -- led00_candr connection
        led00_gls_reset                          : out  std_logic;
        led00_gls_clk                            : out  std_logic;

        -- atmega_nodir_wb8_wrapper00_mwb8 connection
        atmega_nodir_wb8_wrapper00_wbm_address   : in   std_logic_vector(14 downto 0);
        atmega_nodir_wb8_wrapper00_wbm_readdata  : out  std_logic_vector(7 downto 0);
        atmega_nodir_wb8_wrapper00_wbm_writedata : in   std_logic_vector(7 downto 0);
        atmega_nodir_wb8_wrapper00_wbm_strobe    : in   std_logic;
        atmega_nodir_wb8_wrapper00_wbm_write     : in   std_logic;
        atmega_nodir_wb8_wrapper00_wbm_ack       : out  std_logic;
        atmega_nodir_wb8_wrapper00_wbm_cycle     : in   std_logic;

        -- atmega_nodir_wb8_wrapper00_candr connection
        atmega_nodir_wb8_wrapper00_reset         : out  std_logic;
        atmega_nodir_wb8_wrapper00_clk           : out  std_logic;

        -- rstext_syscon00_atmega_nodir_wb8_wrapper00 connection
        rstext_syscon00_gls_clk                  : in   std_logic;
        rstext_syscon00_gls_reset                : in   std_logic
    );
end entity;

architecture atmega_nodir_wb8_wrapper00_mwb8_1 of atmega_nodir_wb8_wrapper00_mwb8 is
    signal adns601000_swb8_cs                       : std_logic := '0' ;
    signal encoder_inc00_swb8_cs                    : std_logic := '0' ;
    signal encoder_inc01_swb8_cs                    : std_logic := '0' ;
    signal encoder_inc02_swb8_cs                    : std_logic := '0' ;
    signal compass00_swb8_cs                        : std_logic := '0' ;
    signal led00_swb8_cs                            : std_logic := '0' ;
begin

    -- Clock and Reset connection
    adns601000_wbs_clk_i                     <= rstext_syscon00_gls_clk;
    adns601000_wbs_rst_i                     <= rstext_syscon00_gls_reset;

    encoder_inc00_wbs_clk_i                  <= rstext_syscon00_gls_clk;
    encoder_inc00_wbs_rst_i                  <= rstext_syscon00_gls_reset;

    encoder_inc01_wbs_clk_i                  <= rstext_syscon00_gls_clk;
    encoder_inc01_wbs_rst_i                  <= rstext_syscon00_gls_reset;

    encoder_inc02_wbs_clk_i                  <= rstext_syscon00_gls_clk;
    encoder_inc02_wbs_rst_i                  <= rstext_syscon00_gls_reset;

    compass00_wbs_clk_i                      <= rstext_syscon00_gls_clk;
    compass00_wbs_rst_i                      <= rstext_syscon00_gls_reset;

    led00_gls_reset                          <= rstext_syscon00_gls_reset;
    led00_gls_clk                            <= rstext_syscon00_gls_clk;

    atmega_nodir_wb8_wrapper00_reset         <= rstext_syscon00_gls_reset;
    atmega_nodir_wb8_wrapper00_clk           <= rstext_syscon00_gls_clk;

    -----------------------
    -- Address decoding  --
    -----------------------
    adns601000_wbs_adr_i <= atmega_nodir_wb8_wrapper00_wbm_address(5 downto 0);
    encoder_inc00_wbs_adr_i <= atmega_nodir_wb8_wrapper00_wbm_address(2 downto 0);
    encoder_inc01_wbs_adr_i <= atmega_nodir_wb8_wrapper00_wbm_address(2 downto 0);
    encoder_inc02_wbs_adr_i <= atmega_nodir_wb8_wrapper00_wbm_address(2 downto 0);
    compass00_wbs_adr_i <= atmega_nodir_wb8_wrapper00_wbm_address(1 downto 0);
    led00_wbs_add <= atmega_nodir_wb8_wrapper00_wbm_address(0);

    decodeproc : process(rstext_syscon00_gls_clk,rstext_syscon00_gls_reset,atmega_nodir_wb8_wrapper00_wbm_address)
    begin
        if rstext_syscon00_gls_reset='1' then
            adns601000_swb8_cs <= '0';
            encoder_inc00_swb8_cs <= '0';
            encoder_inc01_swb8_cs <= '0';
            encoder_inc02_swb8_cs <= '0';
            compass00_swb8_cs <= '0';
            led00_swb8_cs <= '0';
        elsif rising_edge(rstext_syscon00_gls_clk) then

			-- adresse 1300
            if atmega_nodir_wb8_wrapper00_wbm_address(14 downto 6)="001001100" and atmega_nodir_wb8_wrapper00_wbm_strobe='1' then
                adns601000_swb8_cs <= '1';
            else
                adns601000_swb8_cs <= '0';
            end if;
			
			-- adresse 1400
            if atmega_nodir_wb8_wrapper00_wbm_address(14 downto 3)="001010000000" and atmega_nodir_wb8_wrapper00_wbm_strobe='1' then
                encoder_inc00_swb8_cs <= '1';
            else
                encoder_inc00_swb8_cs <= '0';
            end if;

            if atmega_nodir_wb8_wrapper00_wbm_address(14 downto 3)="001010100000" and atmega_nodir_wb8_wrapper00_wbm_strobe='1' then
                encoder_inc01_swb8_cs <= '1';
            else
                encoder_inc01_swb8_cs <= '0';
            end if;

            if atmega_nodir_wb8_wrapper00_wbm_address(14 downto 3)="001011000000" and atmega_nodir_wb8_wrapper00_wbm_strobe='1' then
                encoder_inc02_swb8_cs <= '1';
            else
                encoder_inc02_swb8_cs <= '0';
            end if;

            if atmega_nodir_wb8_wrapper00_wbm_address(14 downto 2)="0010111000000" and atmega_nodir_wb8_wrapper00_wbm_strobe='1' then
                compass00_swb8_cs <= '1';
            else
                compass00_swb8_cs <= '0';
            end if;

            if atmega_nodir_wb8_wrapper00_wbm_address(14 downto 1)="00110000000000" and atmega_nodir_wb8_wrapper00_wbm_strobe='1' then
                led00_swb8_cs <= '1';
            else
                led00_swb8_cs <= '0';
            end if;

        end if;
    end process decodeproc;

    -----------------------------
    -- Control signals to slave
    -----------------------------

    -- for adns601000
    adns601000_wbs_stb_i <= (atmega_nodir_wb8_wrapper00_wbm_strobe and adns601000_swb8_cs );
    adns601000_wbs_cyc_i <= (atmega_nodir_wb8_wrapper00_wbm_cycle and adns601000_swb8_cs );
    adns601000_wbs_we_i <= (atmega_nodir_wb8_wrapper00_wbm_write and adns601000_swb8_cs );
    adns601000_wbs_dat_i <= atmega_nodir_wb8_wrapper00_wbm_writedata when (atmega_nodir_wb8_wrapper00_wbm_write and adns601000_swb8_cs ) = '1' else (others => '0');

    -- for encoder_inc00
    encoder_inc00_wbs_stb_i <= (atmega_nodir_wb8_wrapper00_wbm_strobe and encoder_inc00_swb8_cs );
    encoder_inc00_wbs_cyc_i <= (atmega_nodir_wb8_wrapper00_wbm_cycle and encoder_inc00_swb8_cs );
    encoder_inc00_wbs_we_i <= '0';

    -- for encoder_inc01
    encoder_inc01_wbs_stb_i <= (atmega_nodir_wb8_wrapper00_wbm_strobe and encoder_inc01_swb8_cs );
    encoder_inc01_wbs_cyc_i <= (atmega_nodir_wb8_wrapper00_wbm_cycle and encoder_inc01_swb8_cs );
    encoder_inc01_wbs_we_i <= '0';

    -- for encoder_inc02
    encoder_inc02_wbs_stb_i <= (atmega_nodir_wb8_wrapper00_wbm_strobe and encoder_inc02_swb8_cs );
    encoder_inc02_wbs_cyc_i <= (atmega_nodir_wb8_wrapper00_wbm_cycle and encoder_inc02_swb8_cs );
    encoder_inc02_wbs_we_i <= '0';

    -- for compass00
    compass00_wbs_stb_i <= (atmega_nodir_wb8_wrapper00_wbm_strobe and compass00_swb8_cs );
    compass00_wbs_cyc_i <= (atmega_nodir_wb8_wrapper00_wbm_cycle and compass00_swb8_cs );
    compass00_wbs_we_i <= '0';

    -- for led00
    led00_wbs_strobe <= (atmega_nodir_wb8_wrapper00_wbm_strobe and led00_swb8_cs );
    led00_wbs_cycle <= (atmega_nodir_wb8_wrapper00_wbm_cycle and led00_swb8_cs );
    led00_wbs_write <= (atmega_nodir_wb8_wrapper00_wbm_write and led00_swb8_cs );
    led00_wbs_writedata <= atmega_nodir_wb8_wrapper00_wbm_writedata when (atmega_nodir_wb8_wrapper00_wbm_write and led00_swb8_cs ) = '1' else (others => '0');


    -------------------------------
    -- Control signal for master --
    -------------------------------
    atmega_nodir_wb8_wrapper00_wbm_readdata <=  adns601000_wbs_dat_o when adns601000_swb8_cs='1' else
                                       encoder_inc00_wbs_dat_o when encoder_inc00_swb8_cs='1' else
                                       encoder_inc01_wbs_dat_o when encoder_inc01_swb8_cs='1' else
                                       encoder_inc02_wbs_dat_o when encoder_inc02_swb8_cs='1' else
                                       compass00_wbs_dat_o when compass00_swb8_cs='1' else
                                       led00_wbs_readdata when led00_swb8_cs='1' else
                                       (others => '0');
    atmega_nodir_wb8_wrapper00_wbm_ack <=  (adns601000_wbs_ack_o and adns601000_swb8_cs)
                                    or 
                                (encoder_inc00_wbs_ack_o and encoder_inc00_swb8_cs)
                                    or 
                                (encoder_inc01_wbs_ack_o and encoder_inc01_swb8_cs)
                                    or 
                                (encoder_inc02_wbs_ack_o and encoder_inc02_swb8_cs)
                                    or 
                                (compass00_wbs_ack_o and compass00_swb8_cs)
                                    or 
                                (led00_wbs_ack and led00_swb8_cs);

end architecture atmega_nodir_wb8_wrapper00_mwb8_1;
